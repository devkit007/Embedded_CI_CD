## boards/arm/de1353/Kconfig.board
```kconfig
# nRF5340 DK NRF5340 board configuration

# Copyright (c) 2019-2020 Nordic Semiconductor ASA
# SPDX-License-Identifier: Apache-2.0

if SOC_NRF5340_CPUAPP_QKAA

config BOARD_DE1353_CPUAPP
	bool "DE1353 Application MCU"

config BOARD_DE1353_CPUAPP_NS
	bool "DE1353 Application MCU non-secure"

endif # SOC_NRF5340_CPUAPP_QKAA

config BOARD_DE1353_CPUNET
	bool "DE1353 Network MCU"
	depends on SOC_NRF5340_CPUNET_QKAA
```

## testcase.yaml
```yaml
tests:
  unity.example_test:
    tags: example
    integration_platforms:
      - qemu_cortex_m3
```
